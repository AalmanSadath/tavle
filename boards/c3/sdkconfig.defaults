## main/Kconfig.projbuild
```kconfig
menu "tavle"

choice TAVLE_VARIANT
    prompt "Firmware variant"
    default TAVLE_VARIANT_C3
    help
        Chip and memory build. Set by variants/<variant>/sdkconfig.defaults;
        pick it with idf.py -DVARIANT=<variant>, not here. Pins and the
        display come from the hardware config at run time.

config TAVLE_VARIANT_C3
    bool "ESP32-C3, 4 MB flash"
    depends on IDF_TARGET_ESP32C3

config TAVLE_VARIANT_S3_N16R8
    bool "ESP32-S3 N16R8: 16 MB flash, 8 MB octal PSRAM"
    depends on IDF_TARGET_ESP32S3

endchoice

config TAVLE_BENCH
    bool "Run refresh-rate benchmark after first draw"
    default n

endmenu
```
